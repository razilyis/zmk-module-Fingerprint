## Kconfig
```kconfig
# TouchPass ZMK Module Configuration

menuconfig ZMK_TOUCHPASS
	bool "TouchPass Fingerprint Module"
	depends on SERIAL
	help
	  Enable TouchPass Fingerprint authentication and password storage.

if ZMK_TOUCHPASS

# Note: UART device and pin assignments are configured via DeviceTree (pinctrl)
# in the shield overlay, not via Kconfig. The uart0 node is used directly.

config ZMK_TOUCHPASS_ALWAYS_ON
    bool "Always-on (Polling) Mode"
    default n
    help
        If enabled, the sensor will constantly poll for fingerprints.
        WARNING: This will significantly increase battery consumption.

config ZMK_TOUCHPASS_SERIAL_RPC
    bool "Enable Serial RPC (for config.html)"
    default n
    depends on USB_CDC_ACM && !ZMK_USB_LOGGING
    help
        Enable JSON-RPC communication over USB Serial for the web configuration tool.
        Cannot be used simultaneously with ZMK_USB_LOGGING: both use the same
        CDC ACM UART. To debug with USB logging, set this option to n.

# Compatibility for ZMK v0.3 / Zephyr 3.5 settings mismatch
config SETTINGS_FS_FILE
    string
    default "/lfs/zmk.settings"
    depends on SETTINGS_FILE

endif # ZMK_TOUCHPASS
```

## dts/bindings/behaviors/zmk,behavior-touchpass.yaml
```yaml
description: TouchPass Fingerprint Behavior

compatible: "zmk,behavior-touchpass"

include: zero_param.yaml

properties:
  "#binding-cells":
    type: int
    const: 0
```
